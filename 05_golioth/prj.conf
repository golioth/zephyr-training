## CMakeLists.txt
```
# SPDX-License-Identifier: Apache-2.0

cmake_minimum_required(VERSION 3.20.0)
find_package(Zephyr REQUIRED HINTS $ENV{ZEPHYR_BASE})
project(blinky)

target_include_directories(app PUBLIC ${ZEPHYR_BASE}/subsys/net/ip)

target_sources(app PRIVATE src/main.c)
```

## prj.conf
```kconfig
#
# Copyright (c) 2023 Golioth, Inc.
#
# SPDX-License-Identifier: Apache-2.0
#

CONFIG_GOLIOTH_FIRMWARE_SDK=y
CONFIG_GOLIOTH_SAMPLE_COMMON=y

# Configure Golioth SDK dependencies
CONFIG_ZVFS_EVENTFD_MAX=14
CONFIG_LOG_PROCESS_THREAD_STACK_SIZE=1536
CONFIG_MBEDTLS_ENABLE_HEAP=y
CONFIG_MBEDTLS_HEAP_SIZE=10240
CONFIG_MBEDTLS_SSL_IN_CONTENT_LEN=2048
CONFIG_MBEDTLS_SSL_OUT_CONTENT_LEN=2048
CONFIG_NETWORKING=y
CONFIG_NET_IPV4=y
CONFIG_ZVFS_OPEN_MAX=23

# Application
CONFIG_MAIN_STACK_SIZE=4096
CONFIG_NET_LOG=y
CONFIG_NET_SHELL=y

CONFIG_GOLIOTH_SETTINGS=y

# Runtime credentials
CONFIG_GOLIOTH_SAMPLE_PSK_ID_MAX_LEN=128
CONFIG_SETTINGS=y
CONFIG_SETTINGS_RUNTIME=y

CONFIG_FLASH=y
CONFIG_FLASH_MAP=y
CONFIG_NVS=y

CONFIG_SHELL=y

# Logging
CONFIG_LOG=y
CONFIG_LOG_BUFFER_SIZE=2048
```

## boards/nrf7002dk_nrf5340_cpuapp.conf
```kconfig
# Boilerplate config handled in socs folder
```

## boards/nrf9160dk_nrf9160_ns.conf
```kconfig
# General config
CONFIG_HEAP_MEM_POOL_SIZE=4096
CONFIG_NEWLIB_LIBC=y

# Networking
CONFIG_NET_SOCKETS_OFFLOAD=y
CONFIG_NET_IPV6=y
CONFIG_NET_IPV6_NBR_CACHE=n
CONFIG_NET_IPV6_MLD=n

# Increase native TLS socket implementation, so that it is chosen instead of
# offloaded nRF91 sockets
CONFIG_NET_SOCKETS_TLS_PRIORITY=35

# Modem library
CONFIG_NRF_MODEM_LIB=y

# LTE connectivity with network connection manager
CONFIG_NRF_MODEM_LIB_NET_IF=y
CONFIG_NRF_MODEM_LIB_NET_IF_AUTO_START=y
CONFIG_NRF_MODEM_LIB_NET_IF_AUTO_CONNECT=y
CONFIG_NET_CONNECTION_MANAGER=y
CONFIG_NET_CONNECTION_MANAGER_MONITOR_STACK_SIZE=1024

# Add Logs for LTE Link Handler
CONFIG_GOLIOTH_SAMPLE_NRF91_LTE_MONITOR=y

# Increased sysworkq size, due to LTE connectivity
CONFIG_SYSTEM_WORKQUEUE_STACK_SIZE=2048

# Disable options y-selected by NCS for no good reason
CONFIG_MBEDTLS_KEY_EXCHANGE_DHE_PSK_ENABLED=n
CONFIG_MBEDTLS_KEY_EXCHANGE_DHE_RSA_ENABLED=n

CONFIG_MODEM_INFO=y
```

## socs/nrf5340_cpuapp.conf
```kconfig
CONFIG_WIFI=y
CONFIG_WIFI_NRF70=y
CONFIG_NRF70_BUSLIB=y

CONFIG_NET_L2_WIFI_SHELL=y
CONFIG_GOLIOTH_SAMPLE_WIFI=y
CONFIG_GOLIOTH_SAMPLE_WIFI_STACK_SIZE=4096

# WPA supplicant
CONFIG_WIFI_NM_WPA_SUPPLICANT=y

CONFIG_NET_L2_ETHERNET=y
CONFIG_NEWLIB_LIBC=y
CONFIG_NET_DHCPV4=y
CONFIG_COMMON_LIBC_MALLOC_ARENA_SIZE=-1

# Recommended by Nordic:
# https://github.com/nrfconnect/sdk-nrf/blob/v3.1.1/samples/wifi/sta/prj.conf#L34-L40
CONFIG_NET_BUF_RX_COUNT=16
CONFIG_NET_BUF_TX_COUNT=32
CONFIG_HEAP_MEM_POOL_SIZE=37000
CONFIG_HEAP_MEM_POOL_IGNORE_MIN=y
CONFIG_NET_TC_TX_COUNT=1

CONFIG_MBEDTLS_HEAP_SIZE=12288
CONFIG_SHELL_STACK_SIZE=6144
```

## boards/nrf7002dk_nrf5340_cpuapp.overlay
```dts
/ {
	aliases {
		training-led = &led2_subnode_label;
	};


	led_childnode_path {
		compatible = "gpio-leds";

		led2_subnode_label: led2_path {
			gpios = <&gpio1 7 GPIO_ACTIVE_HIGH>;
	       	};
	};
};
```

## boards/nrf9160dk_nrf9160_ns.overlay
```dts
/ {
	aliases {
		training-led = &led2_subnode_label;
	};


	led_childnode_path {
		compatible = "gpio-leds";

		led2_subnode_label: led2_path {
			gpios = <&gpio0 3 GPIO_ACTIVE_HIGH>;
	       	};
	};
};
```

## src/main.c
```c
/*
 * Copyright (c) 2016 Intel Corporation
 *
 * SPDX-License-Identifier: Apache-2.0
 */

#include <zephyr/logging/log.h>
LOG_MODULE_REGISTER(add_golioth, LOG_LEVEL_DBG);

#include <zephyr/kernel.h>
#include <zephyr/drivers/gpio.h>

/* Includes for connectivity */
#include <zephyr/net/coap.h>

/* Helper functions for passing credentials to Golioth client */
#include <samples/common/sample_credentials.h>

#include <samples/common/net_connect.h>

/* 1000 msec = 1 sec */
#define SLEEP_TIME_MS   1000

/* The devicetree node identifiers for the "led0" and "training_led" */
#define LED0_NODE DT_ALIAS(led0)
#define LED1_NODE DT_ALIAS(training_led)

/*
 * A build error on this line means your board is unsupported.
 * See the sample documentation for information on how to fix this.
 */
static const struct gpio_dt_spec led1 = GPIO_DT_SPEC_GET(LED0_NODE, gpios);
static const struct gpio_dt_spec led2 = GPIO_DT_SPEC_GET(LED1_NODE, gpios);

/* Blink LED1 using a Zephyr Timer */
extern void my_timer_handler(struct k_timer *dummy) {
	gpio_pin_toggle_dt(&led1);
}

K_TIMER_DEFINE(my_timer, my_timer_handler, NULL);

/* Blink LED2 using a Zephyr Thread */
static void my_thread_handler(void *dummy1, void *dummy2, void *dummy3) {
	if (!device_is_ready(led2.port)) {
		return;
	}

	int ret = gpio_pin_configure_dt(&led2, GPIO_OUTPUT_ACTIVE);
	if (ret < 0) {
		return;
	}

	while (1) {
		gpio_pin_toggle_dt(&led2);
		k_sleep(K_SECONDS(1));
	}
}

K_THREAD_DEFINE(my_thread, 1024,
                my_thread_handler, NULL, NULL, NULL,
                K_LOWEST_APPLICATION_THREAD_PRIO, 0, 0);

/* Main function */
int main(void)
{
	int ret;

	if (!device_is_ready(led1.port)) {
		return -EIO;
	}

	ret = gpio_pin_configure_dt(&led1, GPIO_OUTPUT_ACTIVE);
	if (ret < 0) {
		return -EIO;
	}

	/* Start timer-based LED blinker */
	k_timer_start(&my_timer, K_MSEC(200), K_MSEC(200));

	/* Start network connection (if necessary) */
	net_connect();

	int counter = 0;

	while (1) {
		printk("This is the main loop: %d\n", counter);
		++counter;
		k_msleep(SLEEP_TIME_MS);
	}
}
```

## src/wifi_util.c
```c
/*
 * Copyright (c) 2022 Nordic Semiconductor ASA
 *
 * SPDX-License-Identifier: LicenseRef-Nordic-5-Clause
 *
 * Copyright (c) 2023 Golioth, Inc.
 *
 * SPDX-License-Identifier: Apache-2.0
 */

#include <zephyr/logging/log.h>
LOG_MODULE_DECLARE(add_golioth, LOG_LEVEL_INF);

#include <nrfx_clock.h>
#include <zephyr/kernel.h>
#include <stdio.h>
#include <stdlib.h>
#include <zephyr/shell/shell.h>
#include <zephyr/sys/printk.h>
#include <zephyr/init.h>

#include <wifi_util.h>
#include <zephyr/net/net_if.h>
#include <zephyr/net/net_event.h>

#include <zephyr/settings/settings.h>

#include <qspi_if.h>

#define WIFI_SHELL_MODULE "wifi"

#define WIFI_SHELL_MGMT_EVENTS (NET_EVENT_WIFI_CONNECT_RESULT |		\
				NET_EVENT_WIFI_DISCONNECT_RESULT)

#define MAX_SSID_LEN        32
#define DHCP_TIMEOUT        70
#define CONNECTION_TIMEOUT  100
#define STATUS_POLLING_MS   300

static struct net_mgmt_event_callback wifi_shell_mgmt_cb;
static struct net_mgmt_event_callback net_shell_mgmt_cb;

static struct {
	const struct shell *sh;
	union {
		struct {
			uint8_t connected	: 1;
			uint8_t connect_result	: 1;
			uint8_t disconnect_requested	: 1;
			uint8_t _unused		: 5;
		};
		uint8_t all;
	};
} context;

static K_SEM_DEFINE(wifi_connected_sem, 0, 1);

int cmd_wifi_status(struct wifi_iface_status *status)
{
	struct net_if *iface = net_if_get_default();

	if (net_mgmt(NET_REQUEST_WIFI_IFACE_STATUS, iface, status,
				sizeof(struct wifi_iface_status))) {
		LOG_INF("Status request failed");

		return -ENOEXEC;
	}
	return 0;
}

static void handle_wifi_connect_result(struct net_mgmt_event_callback *cb)
{
	const struct wifi_status *status =
		(const struct wifi_status *) cb->info;

	if (context.connected) {
		return;
	}

	if (status->status) {
		LOG_ERR("Connection failed (%d)", status->status);
	} else {
		LOG_INF("Connected");
		context.connected = true;
		k_sem_give(&wifi_connected_sem);
	}

	context.connect_result = true;
}

static void handle_wifi_disconnect_result(struct net_mgmt_event_callback *cb)
{
	const struct wifi_status *status =
		(const struct wifi_status *) cb->info;

	if (!context.connected) {
		return;
	}

	if (context.disconnect_requested) {
		LOG_INF("Disconnection request %s (%d)",
			 status->status ? "failed" : "done",
					status->status);
		context.disconnect_requested = false;
	} else {
		LOG_INF("Received Disconnected");
		context.connected = false;
	}
}

static void wifi_mgmt_event_handler(struct net_mgmt_event_callback *cb,
				     uint32_t mgmt_event, struct net_if *iface)
{
	switch (mgmt_event) {
	case NET_EVENT_WIFI_CONNECT_RESULT:
		handle_wifi_connect_result(cb);
		break;
	case NET_EVENT_WIFI_DISCONNECT_RESULT:
		handle_wifi_disconnect_result(cb);
		break;
	default:
		break;
	}
}

static void print_dhcp_ip(struct net_mgmt_event_callback *cb)
{
	/* Get DHCP info from struct net_if_dhcpv4 and print */
	const struct net_if_dhcpv4 *dhcpv4 = cb->info;
	const struct in_addr *addr = &dhcpv4->requested_ip;
	char dhcp_info[128];

	net_addr_ntop(AF_INET, addr, dhcp_info, sizeof(dhcp_info));

	LOG_INF("DHCP IP address: %s", dhcp_info);
}

static void net_mgmt_event_handler(struct net_mgmt_event_callback *cb,
				    uint32_t mgmt_event, struct net_if *iface)
{
	switch (mgmt_event) {
	case NET_EVENT_IPV4_DHCP_BOUND:
		print_dhcp_ip(cb);
		break;
	default:
		break;
	}
}

/* From Golioth Common wifi.c */
static uint8_t wifi_ssid[WIFI_SSID_MAX_LEN];
static size_t wifi_ssid_len;
static uint8_t wifi_psk[WIFI_PSK_MAX_LEN];
static size_t wifi_psk_len;

static int wifi_settings_get(const char *name, char *dst, int val_len_max)
{
	uint8_t *val;
	size_t val_len;

	if (!strcmp(name, "ssid")) {
		val = wifi_ssid;
		val_len = wifi_ssid_len;
	} else if (!strcmp(name, "psk")) {
		val = wifi_psk;
		val_len = wifi_psk_len;
	} else {
		LOG_WRN("Unsupported key '%s'", name);
		return -ENOENT;
	}

	if (val_len > val_len_max) {
		LOG_ERR("Not enough space (%zu %d)", val_len, val_len_max);
		return -ENOMEM;
	}

	memcpy(dst, val, val_len);

	return val_len;
}

static int wifi_settings_set(const char *name, size_t len_rd,
			     settings_read_cb read_cb, void *cb_arg)
{
	uint8_t *buffer;
	size_t buffer_len;
	size_t *ret_len;
	ssize_t ret;

	if (!strcmp(name, "ssid")) {
		buffer = wifi_ssid;
		buffer_len = sizeof(wifi_ssid);
		ret_len = &wifi_ssid_len;
	} else if (!strcmp(name, "psk")) {
		buffer = wifi_psk;
		buffer_len = sizeof(wifi_psk);
		ret_len = &wifi_psk_len;
	} else {
		LOG_WRN("Unsupported key '%s'", name);
		return -ENOENT;
	}

	ret = read_cb(cb_arg, buffer, buffer_len);
	if (ret < 0) {
		LOG_ERR("Failed to read value: %d", (int) ret);
		return ret;
	}

	*ret_len = ret;

	return 0;
}

SETTINGS_STATIC_HANDLER_DEFINE(wifi, "wifi",
	IS_ENABLED(CONFIG_SETTINGS_RUNTIME) ? wifi_settings_get : NULL,
	wifi_settings_set, NULL, NULL);
/* End Golioth common wifi.c */

static int __wifi_args_to_params(struct wifi_connect_req_params *params)
{
	params->timeout = SYS_FOREVER_MS;

	/* SSID */
	params->ssid = wifi_ssid;
	params->ssid_length = wifi_ssid_len;

#if defined(CONFIG_STA_KEY_MGMT_WPA2)
	params->security = 1;
#elif defined(CONFIG_STA_KEY_MGMT_WPA2_256)
	params->security = 2;
#elif defined(CONFIG_STA_KEY_MGMT_WPA3)
	params->security = 3;
#else
	params->security = 0;
#endif

#if !defined(CONFIG_STA_KEY_MGMT_NONE)
	params->psk = wifi_psk;
	params->psk_length = wifi_psk_len;
#endif
	params->channel = WIFI_CHANNEL_ANY;

	/* MFP (optional) */
	params->mfp = WIFI_MFP_OPTIONAL;

	return 0;
}

int wifi_connect(void)
{
	struct net_if *iface = net_if_get_default();
	static struct wifi_connect_req_params cnx_params;

	memset(&context, 0, sizeof(context));

	net_mgmt_init_event_callback(&wifi_shell_mgmt_cb,
				     wifi_mgmt_event_handler,
				     WIFI_SHELL_MGMT_EVENTS);

	net_mgmt_add_event_callback(&wifi_shell_mgmt_cb);


	net_mgmt_init_event_callback(&net_shell_mgmt_cb,
				     net_mgmt_event_handler,
				     NET_EVENT_IPV4_DHCP_BOUND);

	net_mgmt_add_event_callback(&net_shell_mgmt_cb);

	LOG_INF("Starting %s with CPU frequency: %d MHz", CONFIG_BOARD, SystemCoreClock/MHZ(1));
	k_sleep(K_SECONDS(1));

	LOG_INF("Static IP address (overridable): %s/%s -> %s",
		CONFIG_NET_CONFIG_MY_IPV4_ADDR,
		CONFIG_NET_CONFIG_MY_IPV4_NETMASK,
		CONFIG_NET_CONFIG_MY_IPV4_GW);

	context.connected = false;
	context.connect_result = false;
	__wifi_args_to_params(&cnx_params);

	if (net_mgmt(NET_REQUEST_WIFI_CONNECT, iface,
		     &cnx_params, sizeof(struct wifi_connect_req_params))) {
		LOG_ERR("Connection request failed");

		return -ENOEXEC;
	}

	LOG_INF("Connection requested");

	k_sem_take(&wifi_connected_sem, K_FOREVER);

	return 0;
}

int bytes_from_str(const char *str, uint8_t *bytes, size_t bytes_len)
{
	size_t i;
	char byte_str[3];

	if (strlen(str) != bytes_len * 2) {
		LOG_ERR("Invalid string length: %zu (expected: %d)\n",
			strlen(str), bytes_len * 2);
		return -EINVAL;
	}

	for (i = 0; i < bytes_len; i++) {
		memcpy(byte_str, str + i * 2, 2);
		byte_str[2] = '\0';
		bytes[i] = strtol(byte_str, NULL, 16);
	}

	return 0;
}
```

## src/wifi_util.h
```c
/*
 * Copyright (c) 2023 Golioth, Inc.
 *
 * SPDX-License-Identifier: Apache-2.0
 */

#ifndef __WIFI_UTIL_H__
#define __WIFI_UTIL_H__

#include <zephyr/net/wifi_mgmt.h>
#include "net_private.h"

int wifi_connect(void);
int cmd_wifi_status(struct wifi_iface_status *status);

#endif
```
