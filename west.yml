## west.yml
```yaml
manifest:
  version: 0.7

  projects:
    - name: golioth
      path: modules/lib/golioth-firmware-sdk
      revision: v0.15.0
      url: https://github.com/golioth/golioth-firmware-sdk
      submodules: true
      west-commands: scripts/west-commands.yml
      import:
        file: west-ncs.yml
        path-prefix: deps
        name-allowlist:
          - nrf
          - zephyr
          - cmsis
          - hal_nordic
          - hostap
          - mbedtls
          - mbedtls-nrf
          - nrfxlib
          - oberon-psa-crypto
          - trusted-firmware-m
          - zcbor

    - name: zephyr-network-info
      path: deps/modules/lib/network-info
      revision: v1.2.1
      url: https://github.com/golioth/zephyr-network-info

  self:
    path: app
    west-commands: utility/west-commands/west-commands.yml
```
