## CMakeLists.txt
```
# SPDX-License-Identifier: Apache-2.0

cmake_minimum_required(VERSION 3.20.0)

find_package(Zephyr REQUIRED HINTS $ENV{ZEPHYR_BASE})
project(golioth_iot)

target_include_directories(app PUBLIC ${ZEPHYR_BASE}/subsys/net/ip)

target_sources(app PRIVATE
	src/main.c
	src/led_blink.c
	src/tem_sensor.c
)
```

## Kconfig.sysbuild
```
#
# Copyright (c) 2026 Golioth, Inc.
#
# SPDX-License-Identifier: Apache-2.0
#

config WIFI_NRF70
	default y if BOARD_NRF7002DK_NRF5340_CPUAPP || BOARD_NRF7002DK_NRF5340_CPUAPP_NS

source "share/sysbuild/Kconfig"
```

## sample.yaml
```
sample:
  description: Wi-Fi station sample
    application
  name: Wi-Fi station
tests:
  sample.nrf7002.sta:
    build_only: true
    integration_platforms:
      - nrf7002dk/nrf5340/cpuapp
    platform_allow: nrf7002dk/nrf5340/cpuapp
    tags: ci_build
  sample.nrf7002_eks.sta:
    build_only: true
    extra_args: SHIELD=nrf7002_ek
    integration_platforms:
      - nrf5340dk_nrf5340_cpuapp
      - nrf52840dk_nrf52840
    platform_allow: nrf5340dk_nrf5340_cpuapp nrf52840dk_nrf52840
    tags: ci_build
```

## prj.conf
```kconfig
#
# Copyright (c) 2023 Golioth, Inc.
#
# SPDX-License-Identifier: Apache-2.0
#

CONFIG_GOLIOTH_FIRMWARE_SDK=y
CONFIG_GOLIOTH_SAMPLE_COMMON=y

# Configure Golioth SDK dependencies
CONFIG_ZVFS_EVENTFD_MAX=14
CONFIG_LOG_PROCESS_THREAD_STACK_SIZE=1536
CONFIG_MBEDTLS_ENABLE_HEAP=y
CONFIG_MBEDTLS_HEAP_SIZE=10240
CONFIG_MBEDTLS_SSL_IN_CONTENT_LEN=2048
CONFIG_MBEDTLS_SSL_OUT_CONTENT_LEN=2048
CONFIG_MBEDTLS_PSA_CRYPTO_C=y
CONFIG_NETWORKING=y
CONFIG_NET_IPV4=y
CONFIG_ZVFS_OPEN_MAX=23

# Application
CONFIG_MAIN_STACK_SIZE=4096
CONFIG_NET_LOG=y
CONFIG_NET_SHELL=y

CONFIG_GOLIOTH_STREAM=y
CONFIG_GOLIOTH_LIGHTDB_STATE=y
CONFIG_LOG_BACKEND_GOLIOTH=y
CONFIG_GOLIOTH_RPC=y
CONFIG_GOLIOTH_SETTINGS=y

# Runtime credentials
CONFIG_GOLIOTH_SAMPLE_PSK_ID_MAX_LEN=128
CONFIG_SETTINGS=y
CONFIG_SETTINGS_RUNTIME=y

CONFIG_REBOOT=y

CONFIG_FLASH=y
CONFIG_FLASH_MAP=y
CONFIG_NVS=y

CONFIG_SHELL=y

# Logging
CONFIG_LOG=y
CONFIG_LOG_BUFFER_SIZE=2048
CONFIG_CBPRINTF_FP_SUPPORT=y

CONFIG_NETWORK_INFO=y
# Longer response length needed for network info
CONFIG_GOLIOTH_RPC_MAX_RESPONSE_LEN=512
```

## boards/nrf7002dk_nrf5340_cpuapp.conf
```kconfig
#
# Copyright (c) 2022 Nordic Semiconductor ASA
#
# SPDX-License-Identifier: LicenseRef-Nordic-5-Clause
#
# Copyright (c) 2023-2024 Golioth, Inc.
#
# SPDX-License-Identifier: Apache-2.0
#

CONFIG_WIFI=y
CONFIG_WIFI_NRF700X=y

# WPA supplicant
CONFIG_WPA_SUPP=y

# These should be in a board file for the nRF7002:
# (Choose only one that applies or none for no WiFi password)
# CONFIG_STA_KEY_MGMT_NONE=y
CONFIG_STA_KEY_MGMT_WPA2=y
# CONFIG_STA_KEY_MGMT_WPA2_256=y
# CONFIG_STA_KEY_MGMT_WPA3=y

# System settings
CONFIG_NEWLIB_LIBC=y
CONFIG_NEWLIB_LIBC_NANO=n

# Networking
CONFIG_NETWORKING=y
CONFIG_NET_SOCKETS=y
CONFIG_NET_LOG=y
CONFIG_NET_IPV4=y
CONFIG_NET_UDP=y
CONFIG_NET_TCP=y
CONFIG_NET_DHCPV4=y

CONFIG_NET_PKT_RX_COUNT=8
CONFIG_NET_PKT_TX_COUNT=8

# Below section is the primary contributor to SRAM and is currently
# tuned for performance, but this will be revisited in the future.
CONFIG_NET_BUF_RX_COUNT=32
CONFIG_NET_BUF_TX_COUNT=32
CONFIG_NET_BUF_DATA_SIZE=128
# Nordic nrf7002dk uses 153600; Add 4000 for app/sdk use
CONFIG_HEAP_MEM_POOL_SIZE=157600
CONFIG_NET_TC_TX_COUNT=1

CONFIG_NET_IF_UNICAST_IPV4_ADDR_COUNT=1
CONFIG_NET_MAX_CONTEXTS=5
CONFIG_NET_CONTEXT_SYNC_RECV=y

CONFIG_INIT_STACKS=y

CONFIG_NET_L2_ETHERNET=y

CONFIG_NET_CONFIG_SETTINGS=y
CONFIG_NET_CONFIG_INIT_TIMEOUT=0

CONFIG_NET_SOCKETS_POLL_MAX=6

# Memories
CONFIG_SYSTEM_WORKQUEUE_STACK_SIZE=2048
CONFIG_NET_TX_STACK_SIZE=4096
CONFIG_NET_RX_STACK_SIZE=4096

# Kernel options
CONFIG_ENTROPY_GENERATOR=y

CONFIG_POSIX_CLOCK=y

CONFIG_NET_CONFIG_MY_IPV4_ADDR="192.168.1.99"
CONFIG_NET_CONFIG_MY_IPV4_NETMASK="255.255.255.0"
CONFIG_NET_CONFIG_MY_IPV4_GW="192.168.1.1"
```

## boards/nrf9160dk_nrf9160_ns.conf
```kconfig
#
# Copyright (c) 2023 Golioth, Inc.
#
# SPDX-License-Identifier: Apache-2.0

# General config
CONFIG_HEAP_MEM_POOL_SIZE=4096
CONFIG_NEWLIB_LIBC=y

# Networking
CONFIG_NET_NATIVE=n
CONFIG_NET_SOCKETS_OFFLOAD=y

# Increase native TLS socket implementation, so that it is chosen instead of
# offloaded nRF91 sockets
CONFIG_NET_SOCKETS_TLS_PRIORITY=35

# LTE link control
CONFIG_LTE_LINK_CONTROL=y
CONFIG_LTE_AUTO_INIT_AND_CONNECT=y

# Modem library
CONFIG_NRF_MODEM_LIB=y
#
# TLS configuration
CONFIG_MBEDTLS_ENABLE_HEAP=y
CONFIG_MBEDTLS_HEAP_SIZE=10240

# Use NCS fork of mbedTLS, as Zephyr built-in mbedTLS integration (CONFIG_MBEDTLS_BUILTIN) is in
# conflict with CONFIG_NRF_SECURITY
CONFIG_MBEDTLS_TLS_LIBRARY=y
CONFIG_MBEDTLS_SSL_PROTO_DTLS=y
CONFIG_MBEDTLS_GCM_C=y
# ... and disable options y-selected by NCS for no good reason
CONFIG_MBEDTLS_KEY_EXCHANGE_DHE_PSK_ENABLED=n
CONFIG_MBEDTLS_KEY_EXCHANGE_DHE_RSA_ENABLED=n
# ... also increase heap size to "high enough to make it work"
CONFIG_MBEDTLS_HEAP_SIZE=49152

CONFIG_MODEM_INFO=y
CONFIG_GOLIOTH_RPC_MAX_RESPONSE_LEN=512
```

## socs/nrf9160_ns.conf
```kconfig
# General config
CONFIG_HEAP_MEM_POOL_SIZE=4096
CONFIG_NEWLIB_LIBC=y

# Networking
CONFIG_NET_SOCKETS_OFFLOAD=y
CONFIG_NET_IPV6=y
CONFIG_NET_IPV6_NBR_CACHE=n
CONFIG_NET_IPV6_MLD=n

# Increase native TLS socket implementation, so that it is chosen instead of
# offloaded nRF91 sockets
CONFIG_NET_SOCKETS_TLS_PRIORITY=35

# Modem library
CONFIG_NRF_MODEM_LIB=y

# LTE connectivity with network connection manager
CONFIG_NRF_MODEM_LIB_NET_IF=y
CONFIG_NRF_MODEM_LIB_NET_IF_AUTO_START=y
CONFIG_NRF_MODEM_LIB_NET_IF_AUTO_CONNECT=y
CONFIG_NET_CONNECTION_MANAGER=y
CONFIG_NET_CONNECTION_MANAGER_MONITOR_STACK_SIZE=1024

# Increased sysworkq size, due to LTE connectivity
CONFIG_SYSTEM_WORKQUEUE_STACK_SIZE=2048

# Disable options y-selected by NCS for no good reason
CONFIG_MBEDTLS_KEY_EXCHANGE_DHE_PSK_ENABLED=n
CONFIG_MBEDTLS_KEY_EXCHANGE_DHE_RSA_ENABLED=n
CONFIG_MBEDTLS_PK_PARSE_EC_EXTENDED=n

# MbedTLS configuration to support p-384 curve. These options
# enable using the MbedTLS built-in support for operations not
# supported by the default nRF Oberon crypto backend
CONFIG_NORDIC_SECURITY_BACKEND=n
CONFIG_MBEDTLS_LEGACY_CRYPTO_C=y

# Generate MCUboot compatible images
CONFIG_BOOTLOADER_MCUBOOT=y

CONFIG_MODEM_INFO=y
```

## src/main.c
```c
/*
 * Copyright (c) 2023-2024 Golioth, Inc.
 *
 * SPDX-License-Identifier: Apache-2.0
 */

#include <zephyr/logging/log.h>
LOG_MODULE_REGISTER(golioth_iot, LOG_LEVEL_DBG);

#include <golioth/client.h>
#include <golioth/lightdb_state.h>
#include <golioth/rpc.h>
#include <golioth/settings.h>
#include <golioth/stream.h>
#include <samples/common/sample_credentials.h>

#include <zcbor_encode.h>
#include <zephyr/drivers/gpio.h>
#include <zephyr/drivers/sensor.h>
#include <zephyr/net/coap.h>

#include "led_blink.h"
#include "tem_sensor.h"
#include <network_info.h>

#include <samples/common/net_connect.h>

#define LOOP_DELAY_S_MIN 1
#define LOOP_DELAY_S_MAX 100
#define BLINK_DELAY_MS_MIN 200
#define BLINK_DELAY_MS_MAX 2000

struct golioth_client *client;
static int32_t _loop_delay_s = 5;
static k_tid_t _system_thread = 0;

static K_SEM_DEFINE(golioth_connected, 0, 1);

#define SW0_N DT_ALIAS(sw0)
#define SW1_N DT_ALIAS(sw1)
static const struct gpio_dt_spec button0 = GPIO_DT_SPEC_GET_OR(SW0_N, gpios, {0});
static const struct gpio_dt_spec button1 = GPIO_DT_SPEC_GET_OR(SW1_N, gpios, {0});
static struct gpio_callback button_cb_data;

uint8_t _led_sel = 0;

void wake_system_thread(void)
{
	k_wakeup(_system_thread);
}

static void selected_led_state_handler(struct golioth_client *client,
				      enum golioth_status status,
				      const struct golioth_coap_rsp_code *coap_rsp_code,
				      const char *path,
				      void *arg)
{
	if (status != GOLIOTH_OK)
	{
		LOG_WRN("Failed to set selected LED state on Golioth: %d", status);
	}
}

void update_lightdb_state_work_handler(struct k_work *work) {
	/* LED labels on board silk screen are +1 from LED Node definitions */
	int err = golioth_lightdb_set_string_async(client,
						   "selected_led",
						   _led_sel ? "LED1" : "LED0",
						   4,
						   selected_led_state_handler,
						   NULL);
	if (err) {
		LOG_WRN("Failed to set selected_led: %d", err);
		return;
	}
}

K_WORK_DEFINE(update_state_work, update_lightdb_state_work_handler);

void button_pressed(const struct device *dev, struct gpio_callback *cb,
		    uint32_t pins)
{
	if (pins & BIT(button0.pin)) {
		_led_sel = 0;
	} else if (pins & BIT(button1.pin)) {
		_led_sel = 1;
	} else {
		LOG_WRN("Ignoring unknown button press even: %d", pins);
		return;
	}

	LOG_INF("Pins: %d", pins);

	led_set_selected(_led_sel);
	led_wake_thread();

	/*
	 * Don't call Golioth APIs from an interrupt;
	 * This worker will run on the system thread
	 */
	k_work_submit(&update_state_work);
}

static enum golioth_settings_status on_loop_delay_setting(int32_t new_value, void *arg)
{
	LOG_INF("Setting loop delay to %d s", new_value);
	_loop_delay_s = new_value;
	return GOLIOTH_SETTINGS_SUCCESS;
}

static enum golioth_settings_status on_blink_delay_setting(int32_t new_value, void *arg)
{
	led_set_delay(new_value);
	LOG_INF("Set blink delay to %d milliseconds", new_value);
	led_wake_thread();
	return GOLIOTH_SETTINGS_SUCCESS;
}

static enum golioth_rpc_status on_multiply(zcbor_state_t *request_params_array,
                                           zcbor_state_t *response_detail_map,
                                           void *callback_arg)
{
	double a, b;
	double value;
	bool ok;

	ok = zcbor_float_decode(request_params_array, &a) &&
	     zcbor_float_decode(request_params_array, &b);
	if (!ok)
	{
		LOG_ERR("Failed to decode array items");
		return GOLIOTH_RPC_INVALID_ARGUMENT;
	}

	value = a * b;

	LOG_DBG("%lf * %lf = %lf", a, b, value);

	ok = zcbor_tstr_put_lit(response_detail_map, "value") &&
	     zcbor_float64_put(response_detail_map, value);
	if (!ok)
	{
		LOG_ERR("Failed to encode value");
		return GOLIOTH_RPC_RESOURCE_EXHAUSTED;
	}

	return GOLIOTH_RPC_OK;
}

static enum golioth_rpc_status on_get_network_info(zcbor_state_t *request_params_array,
						   zcbor_state_t *response_detail_map,
						   void *callback_arg)
{
	network_info_add_to_map(response_detail_map);

	return GOLIOTH_RPC_OK;
}

static void on_client_event(struct golioth_client *client,
			    enum golioth_client_event event,
			    void *arg)
{
	bool is_connected = (event == GOLIOTH_CLIENT_EVENT_CONNECTED);
	if (is_connected)
	{
		k_sem_give(&golioth_connected);
	}
	LOG_INF("Golioth client %s", is_connected ? "connected" : "disconnected");
}

static void temperature_push_handler(struct golioth_client *client,
				     enum golioth_status status,
				     const struct golioth_coap_rsp_code *coap_rsp_code,
				     const char *path, void *arg) {

	if (status != GOLIOTH_OK) {
		LOG_WRN("Failed to push temperature: %d", status);
		return;
	}

	LOG_DBG("Temperature successfully pushed");

	return;
}

int main(void)
{
	struct sensor_value temperature;
	int counter = 0;
	int err;
	uint8_t buf[16];

	LOG_DBG("Start Golioth IoT");

	/* Get system thread id so loop delay change event can wake main */
	_system_thread = k_current_get();

	gpio_pin_configure_dt(&button0, GPIO_INPUT);
	gpio_pin_configure_dt(&button1, GPIO_INPUT);
	gpio_pin_interrupt_configure_dt(&button0, GPIO_INT_EDGE_TO_ACTIVE);
	gpio_pin_interrupt_configure_dt(&button1, GPIO_INT_EDGE_TO_ACTIVE);
	gpio_init_callback(&button_cb_data, button_pressed, BIT(button0.pin) | BIT(button1.pin));
	/* Buttons share the same port; this will add callback for both */
	gpio_add_callback(button0.port, &button_cb_data);

	net_connect();

	const struct golioth_client_config *client_config = golioth_sample_credentials_get();

	client = golioth_client_create(client_config);
	struct golioth_rpc *rpc = golioth_rpc_init(client);
	struct golioth_settings *settings = golioth_settings_init(client);

	golioth_client_register_event_callback(client, on_client_event, NULL);
	k_sem_take(&golioth_connected, K_FOREVER);

	golioth_rpc_register(rpc, "get_network_info", on_get_network_info, NULL);
	golioth_rpc_register(rpc, "multiply", on_multiply, NULL);
	golioth_settings_register_int_with_range(settings, "LOOP_DELAY_S", LOOP_DELAY_S_MIN, LOOP_DELAY_S_MAX, on_loop_delay_setting, NULL);
	golioth_settings_register_int_with_range(settings, "BLINK_DELAY_MS", BLINK_DELAY_MS_MIN, BLINK_DELAY_MS_MAX, on_blink_delay_setting, NULL);

	while (true) {
		LOG_INF("Hello Golioth! %d", counter);

		get_temperature(&temperature);

		/* Create zcbor state variable for encoding */
		ZCBOR_STATE_E(zcbor_e_state, 1, buf, sizeof(buf), 1);

		bool ok = zcbor_map_start_encode(zcbor_e_state, 1) &&
			  zcbor_tstr_put_lit(zcbor_e_state, "temp") &&
			  zcbor_float64_put(zcbor_e_state, sensor_value_to_double(&temperature)) &&
			  zcbor_map_end_encode(zcbor_e_state, 1);

		if (ok) {
			size_t payload_length = zcbor_e_state->payload - buf;

                        LOG_INF("Streaming Temperature to Golioth: %i.%06u",
                                temperature.val1, abs(temperature.val2));

                        err = golioth_stream_set_async(client,
						       "",
						       GOLIOTH_CONTENT_TYPE_CBOR,
						       buf,
						       payload_length,
						       temperature_push_handler,
						       NULL);
                        if (err) {
                          LOG_WRN("Failed to push temperature: %d", err);
                        }

                } else {
			LOG_ERR("Error encoding CBOR packet");
		}

		++counter;

		k_sleep(K_SECONDS(_loop_delay_s));
	}
}
```

## src/led_blink.c
```c
/*
 * Copyright (c) 2023 Golioth, Inc.
 *
 * SPDX-License-Identifier: Apache-2.0
 */

#include <zephyr/kernel.h>
#include <zephyr/drivers/gpio.h>

#define LED0_N DT_ALIAS(led0)
#define LED1_N DT_ALIAS(led1)
static const struct gpio_dt_spec led0 = GPIO_DT_SPEC_GET(LED0_N, gpios);
static const struct gpio_dt_spec led1 = GPIO_DT_SPEC_GET(LED1_N, gpios);

uint32_t _blink_delay_ms = 250;
struct gpio_dt_spec *_selected_led;
K_MUTEX_DEFINE(led_mutex);

void led_set_selected(uint8_t sel)
{
	if (sel) {
		_selected_led = (void *)&led1;
	} else {
		_selected_led = (void *)&led0;
	}
}

extern void led_blink(void) {
	gpio_pin_configure_dt(&led0, GPIO_OUTPUT_INACTIVE);
	gpio_pin_configure_dt(&led1, GPIO_OUTPUT_INACTIVE);

	led_set_selected(1);

	while (1) {
		if (k_mutex_lock(&led_mutex, K_MSEC(5)) == 0) {
			gpio_pin_toggle_dt(_selected_led);
			k_mutex_unlock(&led_mutex);
		}
		k_sleep(K_MSEC(_blink_delay_ms));
	}
}
K_THREAD_DEFINE(blink_thread_id, 1024, led_blink, NULL, NULL, NULL, 5, 0, 0);

void led_wake_thread(void)
{
	if (k_mutex_lock(&led_mutex, K_MSEC(5)) == 0) {
		gpio_pin_set_dt(&led0, 0);
		gpio_pin_set_dt(&led1, 0);
		k_mutex_unlock(&led_mutex);
	}
	k_wakeup(blink_thread_id);
}

void led_set_delay(uint32_t delay)
{
	_blink_delay_ms = delay;
	led_wake_thread();
}
```

## src/led_blink.h
```c
/*
 * Copyright (c) 2023 Golioth, Inc.
 *
 * SPDX-License-Identifier: Apache-2.0
 */

#ifndef __LED_BLINK_H__
#define __LED_BLINK_H__

#include <stdint.h>

void led_set_selected(uint8_t sel);
void led_wake_thread(void);
void led_set_delay(uint32_t delay);

#endif
```

## src/network_info.c
```c
/*
 * Copyright (c) 2023 Golioth, Inc.
 *
 * SPDX-License-Identifier: Apache-2.0
 */

#include <zephyr/logging/log.h>
LOG_MODULE_REGISTER(net_info, LOG_LEVEL_DBG);

#include "network_info.h"

#ifdef CONFIG_MODEM_INFO
#include <modem/modem_info.h>
#endif

#ifdef CONFIG_BOARD_NRF7002DK_NRF5340_CPUAPP
#include "wifi_util.h"
#endif

int add_network_info_to_map(QCBOREncodeContext *response_detail_map)
{
#if defined CONFIG_BOARD_NRF7002DK_NRF5340_CPUAPP

	struct wifi_iface_status w_status = { 0 };

	cmd_wifi_status(&w_status);

	QCBOREncode_AddSZStringToMap(response_detail_map, "State", wifi_state_txt(w_status.state));

	if (w_status.state >= WIFI_STATE_ASSOCIATED) {
		uint8_t mac_string_buf[sizeof("xx:xx:xx:xx:xx:xx")];
		QCBOREncode_AddSZStringToMap(response_detail_map,
					     "Interface Mode",
					     wifi_mode_txt(w_status.iface_mode));
		QCBOREncode_AddSZStringToMap(response_detail_map,
					     "Link Mode",
					     wifi_link_mode_txt(w_status.link_mode));
		QCBOREncode_AddSZStringToMap(response_detail_map,
					     "SSID", w_status.ssid);
		QCBOREncode_AddSZStringToMap(response_detail_map,
					     "BSSID",
					     net_sprint_ll_addr_buf(w_status.bssid,
								    WIFI_MAC_ADDR_LEN,
								    mac_string_buf,
								    sizeof(mac_string_buf))
					     );
		QCBOREncode_AddSZStringToMap(response_detail_map, "Band",
					     wifi_band_txt(w_status.band));
		QCBOREncode_AddDoubleToMap(response_detail_map,
					   "Channel", w_status.channel);
		QCBOREncode_AddSZStringToMap(response_detail_map,
					     "Security",
					     wifi_security_txt(w_status.security));
		QCBOREncode_AddSZStringToMap(response_detail_map, "MFP", wifi_mfp_txt(w_status.mfp));
		QCBOREncode_AddDoubleToMap(response_detail_map, "RSSI", w_status.rssi);
	}

#elif defined CONFIG_MODEM_INFO

	char sbuf[128];
	modem_info_string_get(MODEM_INFO_RSRP, sbuf, sizeof(sbuf));
	LOG_INF("Signal strength: %s", sbuf);
	QCBOREncode_AddSZStringToMap(response_detail_map,
				     "Signal strength",
				     sbuf);
	modem_info_string_get(MODEM_INFO_CUR_BAND, sbuf, sizeof(sbuf));
	LOG_INF("Current LTE band: %s", sbuf);
	QCBOREncode_AddSZStringToMap(response_detail_map,
				     "Current LTE band",
				     sbuf);
	modem_info_string_get(MODEM_INFO_SUP_BAND, sbuf, sizeof(sbuf));
	LOG_INF("Supported LTE bands: %s", sbuf);
	QCBOREncode_AddSZStringToMap(response_detail_map,
				     "Supported LTE bands",
				     sbuf);
	modem_info_string_get(MODEM_INFO_AREA_CODE, sbuf, sizeof(sbuf));
	LOG_INF("Tracking area code: %s", sbuf);
	QCBOREncode_AddSZStringToMap(response_detail_map,
				     "Tracking area code",
				     sbuf);
	modem_info_string_get(MODEM_INFO_UE_MODE, sbuf, sizeof(sbuf));
	LOG_INF("Current mode: %s", sbuf);
	QCBOREncode_AddSZStringToMap(response_detail_map,
				     "Current mode",
				     sbuf);
	modem_info_string_get(MODEM_INFO_OPERATOR, sbuf, sizeof(sbuf));
	LOG_INF("Current operator name: %s", sbuf);
	QCBOREncode_AddSZStringToMap(response_detail_map,
				     "Current operator name",
				     sbuf);
	modem_info_string_get(MODEM_INFO_CELLID, sbuf, sizeof(sbuf));
	LOG_INF("Cell ID of the device: %s", sbuf);
	QCBOREncode_AddSZStringToMap(response_detail_map,
				     "Cell ID of the device",
				     sbuf);
	modem_info_string_get(MODEM_INFO_IP_ADDRESS, sbuf, sizeof(sbuf));
	LOG_INF("IP address of the device: %s", sbuf);
	QCBOREncode_AddSZStringToMap(response_detail_map,
				     "IP address of the device",
				     sbuf);
	modem_info_string_get(MODEM_INFO_FW_VERSION, sbuf, sizeof(sbuf));
	LOG_INF("Modem firmware version: %s", sbuf);
	QCBOREncode_AddSZStringToMap(response_detail_map,
				     "Modem firmware version",
				     sbuf);
	modem_info_string_get(MODEM_INFO_LTE_MODE, sbuf, sizeof(sbuf));
	LOG_INF("LTE-M support mode: %s", sbuf);
	QCBOREncode_AddSZStringToMap(response_detail_map,
				     "LTE-M support mode",
				     sbuf);
	modem_info_string_get(MODEM_INFO_NBIOT_MODE, sbuf, sizeof(sbuf));
	LOG_INF("NB-IoT support mode: %s", sbuf);
	QCBOREncode_AddSZStringToMap(response_detail_map,
				     "NB-IoT support mode",
				     sbuf);
	modem_info_string_get(MODEM_INFO_GPS_MODE, sbuf, sizeof(sbuf));
	LOG_INF("GPS support mode: %s", sbuf);
	QCBOREncode_AddSZStringToMap(response_detail_map,
				     "GPS support mode",
				     sbuf);
	modem_info_string_get(MODEM_INFO_DATE_TIME, sbuf, sizeof(sbuf));
	LOG_INF("Mobile network time and date: %s", sbuf);
	QCBOREncode_AddSZStringToMap(response_detail_map,
				     "Mobile network time and date",
				     sbuf);

#else

	QCBOREncode_AddSZStringToMap(response_detail_map,
				     "No Network Info",
				     "Network reporting not implemented "
				     "for this board");

#endif
	return 0;
}
```

## src/network_info.h
```c
/*
 * Copyright (c) 2023 Golioth, Inc.
 *
 * SPDX-License-Identifier: Apache-2.0
 */

#ifndef __NETWORK_INFO_H__
#define __NETWORK_INFO_H__

#include <qcbor/qcbor.h>

int add_network_info_to_map(QCBOREncodeContext *response_detail_map);

#endif
```

## src/tem_sensor.c
```c
/*
 * Copyright (c) 2023 Golioth, Inc.
 *
 * SPDX-License-Identifier: Apache-2.0
 */

#include <zephyr/drivers/sensor.h>
#include <zephyr/random/random.h>

#define TEM_GEN_DELAY_S 1
#define TEM_MIN 20
#define TEM_MAX 38
#define DELTA_LIMIT_HUNDREDTHS 50

static struct sensor_value _temperature = { .val1 = 27, .val2 = 340000 };

K_MUTEX_DEFINE(temperature_mutex);

static int32_t get_tem_large(struct sensor_value *s)
{
	return (s->val1 * 1000000) + s->val2;
}

static void set_sensor_value(int32_t tem_large, struct sensor_value *s)
{
	s->val1 = tem_large / 1000000;
	s->val2 = tem_large % 1000000;
}

static void update_temperature(struct sensor_value *tem)
{
	int32_t min = TEM_MIN * 1000000;
	int32_t max = TEM_MAX * 1000000;

	int32_t delta = (sys_rand32_get() % (DELTA_LIMIT_HUNDREDTHS + 1)) - (DELTA_LIMIT_HUNDREDTHS / 2);
	int32_t tem_large = get_tem_large(tem) + (delta * 10000);

	if (tem_large < min) {
		tem_large = min;
	} else if (tem_large > max) {
		tem_large = max;
	}

	k_mutex_lock(&temperature_mutex, K_FOREVER);
	set_sensor_value(tem_large, tem);
	k_mutex_unlock(&temperature_mutex);
}

static void generate_temperature(void)
{
	while (1) {
		update_temperature(&_temperature);
		k_sleep(K_SECONDS(TEM_GEN_DELAY_S));
	}
}
K_THREAD_DEFINE(temperature_thread_id, 1024, generate_temperature, NULL, NULL,
		NULL, 5, 0, 0);

void get_temperature(struct sensor_value *tem)
{
	if (k_mutex_lock(&temperature_mutex, K_MSEC(5)) == 0) {
		tem->val1 = _temperature.val1;
		tem->val2 = _temperature.val2;
		k_mutex_unlock(&temperature_mutex);
	}
}
```

## src/tem_sensor.h
```c
/*
 * Copyright (c) 2023 Golioth, Inc.
 *
 * SPDX-License-Identifier: Apache-2.0
 */

#ifndef __TEM_SENSOR_H__
#define __TEM_SENSOR_H__

#include <zephyr/drivers/sensor.h>

/**
 * @brief Get simulated temperature sensor data
 *
 * Temperature is generated with two decimal places of precision to simulate the
 * type of readings that would be received from a BME280 sensor.
 *
 * @param tem sensor_value point to store the new temperature values. val1 is
 * the integral part, val2 is the decimal part and returns six digits of
 * precision to adhere to the Zephyr sensor API.
 */
void get_temperature(struct sensor_value *tem);

#endif
```

## src/wifi_util.c
```c
/*
 * Copyright (c) 2022 Nordic Semiconductor ASA
 *
 * SPDX-License-Identifier: LicenseRef-Nordic-5-Clause
 *
 * Copyright (c) 2023 Golioth, Inc.
 *
 * SPDX-License-Identifier: Apache-2.0
 */

#include <zephyr/logging/log.h>
LOG_MODULE_DECLARE(golioth_iot, LOG_LEVEL_INF);

#include <nrfx_clock.h>
#include <zephyr/kernel.h>
#include <stdio.h>
#include <stdlib.h>
#include <zephyr/shell/shell.h>
#include <zephyr/sys/printk.h>
#include <zephyr/init.h>

#include <wifi_util.h>
#include <zephyr/net/net_if.h>
#include <zephyr/net/net_event.h>

#include <zephyr/settings/settings.h>

#include <qspi_if.h>

#define WIFI_SHELL_MODULE "wifi"

#define WIFI_SHELL_MGMT_EVENTS (NET_EVENT_WIFI_CONNECT_RESULT |		\
				NET_EVENT_WIFI_DISCONNECT_RESULT)

#define MAX_SSID_LEN        32
#define DHCP_TIMEOUT        70
#define CONNECTION_TIMEOUT  100
#define STATUS_POLLING_MS   300

static struct net_mgmt_event_callback wifi_shell_mgmt_cb;
static struct net_mgmt_event_callback net_shell_mgmt_cb;

static struct {
	const struct shell *sh;
	union {
		struct {
			uint8_t connected	: 1;
			uint8_t connect_result	: 1;
			uint8_t disconnect_requested	: 1;
			uint8_t _unused		: 5;
		};
		uint8_t all;
	};
} context;

static K_SEM_DEFINE(wifi_connected_sem, 0, 1);

int cmd_wifi_status(struct wifi_iface_status *status)
{
	struct net_if *iface = net_if_get_default();

	if (net_mgmt(NET_REQUEST_WIFI_IFACE_STATUS, iface, status,
				sizeof(struct wifi_iface_status))) {
		LOG_INF("Status request failed");

		return -ENOEXEC;
	}
	return 0;
}

static void handle_wifi_connect_result(struct net_mgmt_event_callback *cb)
{
	const struct wifi_status *status =
		(const struct wifi_status *) cb->info;

	if (context.connected) {
		return;
	}

	if (status->status) {
		LOG_ERR("Connection failed (%d)", status->status);
	} else {
		LOG_INF("Connected");
		context.connected = true;
		k_sem_give(&wifi_connected_sem);
	}

	context.connect_result = true;
}

static void handle_wifi_disconnect_result(struct net_mgmt_event_callback *cb)
{
	const struct wifi_status *status =
		(const struct wifi_status *) cb->info;

	if (!context.connected) {
		return;
	}

	if (context.disconnect_requested) {
		LOG_INF("Disconnection request %s (%d)",
			 status->status ? "failed" : "done",
					status->status);
		context.disconnect_requested = false;
	} else {
		LOG_INF("Received Disconnected");
		context.connected = false;
	}
}

static void wifi_mgmt_event_handler(struct net_mgmt_event_callback *cb,
				     uint32_t mgmt_event, struct net_if *iface)
{
	switch (mgmt_event) {
	case NET_EVENT_WIFI_CONNECT_RESULT:
		handle_wifi_connect_result(cb);
		break;
	case NET_EVENT_WIFI_DISCONNECT_RESULT:
		handle_wifi_disconnect_result(cb);
		break;
	default:
		break;
	}
}

static void print_dhcp_ip(struct net_mgmt_event_callback *cb)
{
	/* Get DHCP info from struct net_if_dhcpv4 and print */
	const struct net_if_dhcpv4 *dhcpv4 = cb->info;
	const struct in_addr *addr = &dhcpv4->requested_ip;
	char dhcp_info[128];

	net_addr_ntop(AF_INET, addr, dhcp_info, sizeof(dhcp_info));

	LOG_INF("DHCP IP address: %s", dhcp_info);
}

static void net_mgmt_event_handler(struct net_mgmt_event_callback *cb,
				    uint32_t mgmt_event, struct net_if *iface)
{
	switch (mgmt_event) {
	case NET_EVENT_IPV4_DHCP_BOUND:
		print_dhcp_ip(cb);
		break;
	default:
		break;
	}
}

/* From Golioth Common wifi.c */
static uint8_t wifi_ssid[WIFI_SSID_MAX_LEN];
static size_t wifi_ssid_len;
static uint8_t wifi_psk[WIFI_PSK_MAX_LEN];
static size_t wifi_psk_len;

static int wifi_settings_get(const char *name, char *dst, int val_len_max)
{
	uint8_t *val;
	size_t val_len;

	if (!strcmp(name, "ssid")) {
		val = wifi_ssid;
		val_len = wifi_ssid_len;
	} else if (!strcmp(name, "psk")) {
		val = wifi_psk;
		val_len = wifi_psk_len;
	} else {
		LOG_WRN("Unsupported key '%s'", name);
		return -ENOENT;
	}

	if (val_len > val_len_max) {
		LOG_ERR("Not enough space (%zu %d)", val_len, val_len_max);
		return -ENOMEM;
	}

	memcpy(dst, val, val_len);

	return val_len;
}

static int wifi_settings_set(const char *name, size_t len_rd,
			     settings_read_cb read_cb, void *cb_arg)
{
	uint8_t *buffer;
	size_t buffer_len;
	size_t *ret_len;
	ssize_t ret;

	if (!strcmp(name, "ssid")) {
		buffer = wifi_ssid;
		buffer_len = sizeof(wifi_ssid);
		ret_len = &wifi_ssid_len;
	} else if (!strcmp(name, "psk")) {
		buffer = wifi_psk;
		buffer_len = sizeof(wifi_psk);
		ret_len = &wifi_psk_len;
	} else {
		LOG_WRN("Unsupported key '%s'", name);
		return -ENOENT;
	}

	ret = read_cb(cb_arg, buffer, buffer_len);
	if (ret < 0) {
		LOG_ERR("Failed to read value: %d", (int) ret);
		return ret;
	}

	*ret_len = ret;

	return 0;
}

SETTINGS_STATIC_HANDLER_DEFINE(wifi, "wifi",
	IS_ENABLED(CONFIG_SETTINGS_RUNTIME) ? wifi_settings_get : NULL,
	wifi_settings_set, NULL, NULL);
/* End Golioth common wifi.c */

static int __wifi_args_to_params(struct wifi_connect_req_params *params)
{
	params->timeout = SYS_FOREVER_MS;

	/* SSID */
	params->ssid = wifi_ssid;
	params->ssid_length = wifi_ssid_len;

#if defined(CONFIG_STA_KEY_MGMT_WPA2)
	params->security = 1;
#elif defined(CONFIG_STA_KEY_MGMT_WPA2_256)
	params->security = 2;
#elif defined(CONFIG_STA_KEY_MGMT_WPA3)
	params->security = 3;
#else
	params->security = 0;
#endif

#if !defined(CONFIG_STA_KEY_MGMT_NONE)
	params->psk = wifi_psk;
	params->psk_length = wifi_psk_len;
#endif
	params->channel = WIFI_CHANNEL_ANY;

	/* MFP (optional) */
	params->mfp = WIFI_MFP_OPTIONAL;

	return 0;
}

int wifi_connect(void)
{
	memset(&context, 0, sizeof(context));

	net_mgmt_init_event_callback(&wifi_shell_mgmt_cb,
				     wifi_mgmt_event_handler,
				     WIFI_SHELL_MGMT_EVENTS);

	net_mgmt_add_event_callback(&wifi_shell_mgmt_cb);


	net_mgmt_init_event_callback(&net_shell_mgmt_cb,
				     net_mgmt_event_handler,
				     NET_EVENT_IPV4_DHCP_BOUND);

	net_mgmt_add_event_callback(&net_shell_mgmt_cb);

	LOG_INF("Starting %s with CPU frequency: %d MHz", CONFIG_BOARD, SystemCoreClock/MHZ(1));
	k_sleep(K_SECONDS(1));

	LOG_INF("Static IP address (overridable): %s/%s -> %s",
		CONFIG_NET_CONFIG_MY_IPV4_ADDR,
		CONFIG_NET_CONFIG_MY_IPV4_NETMASK,
		CONFIG_NET_CONFIG_MY_IPV4_GW);

	struct net_if *iface = net_if_get_default();
	static struct wifi_connect_req_params cnx_params;

	context.connected = false;
	context.connect_result = false;
	__wifi_args_to_params(&cnx_params);

	if (net_mgmt(NET_REQUEST_WIFI_CONNECT, iface,
		     &cnx_params, sizeof(struct wifi_connect_req_params))) {
		LOG_ERR("Connection request failed");

		return -ENOEXEC;
	}

	LOG_INF("Connection requested");

	k_sem_take(&wifi_connected_sem, K_FOREVER);

	return 0;
}

int bytes_from_str(const char *str, uint8_t *bytes, size_t bytes_len)
{
	size_t i;
	char byte_str[3];

	if (strlen(str) != bytes_len * 2) {
		LOG_ERR("Invalid string length: %zu (expected: %d)\n",
			strlen(str), bytes_len * 2);
		return -EINVAL;
	}

	for (i = 0; i < bytes_len; i++) {
		memcpy(byte_str, str + i * 2, 2);
		byte_str[2] = '\0';
		bytes[i] = strtol(byte_str, NULL, 16);
	}

	return 0;
}
```

## src/wifi_util.h
```c
/*
 * Copyright (c) 2023 Golioth, Inc.
 *
 * SPDX-License-Identifier: Apache-2.0
 */

#ifndef __WIFI_UTIL_H__
#define __WIFI_UTIL_H__

int wifi_connect(void);

#endif
```
